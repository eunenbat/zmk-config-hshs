// config/hshs46_studio.overlay

#include "boards/shields/hshs46/hshs46.dtsi"

/ {
    chosen {
        // This is the CRITICAL LINE for the BUILD_ASSERT check:
        zmk,physical-layout = &physical_layout0; 

        // This is the ZMK Studio communication link:
        zmk,studio-rpc-uart = &cdc_acm_uart;
    };
};

// Define the KSCAN columns ONLY in this overlay for the left side
&kscan0 {
    col-gpios
        = <&pro_micro 19 GPIO_ACTIVE_HIGH> // col0 
        , <&pro_micro 18 GPIO_ACTIVE_HIGH> // col1
        , <&pro_micro 15 GPIO_ACTIVE_HIGH> // col2
        , <&pro_micro 14 GPIO_ACTIVE_HIGH> // col3
        , <&pro_micro 16 GPIO_ACTIVE_HIGH> // col4
        , <&pro_micro 10 GPIO_ACTIVE_HIGH> // col5
        ;
};
